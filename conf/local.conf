## conf/local.conf
```bitbake
MACHINE = "orange-pi-r1"

DISTRO ?= "poky"

EXTRA_IMAGE_FEATURES += "debug-tweaks"

CONF_VERSION = "2"

EXTRA_IMAGE_FEATURES += "ssh-server-openssh"

DISTRO_FEATURES:append = "opengl"

PACKAGECONFIG:append:pn-qtbase = " gles2 eglfs linuxfb fontconfig"

#PREFERRED_PROVIDER_virtual/libgl = "mesa"
#PREFERRED_PROVIDER_virtual/mesa = "mesa"
#PREFERRED_PROVIDER_virtual/libgles1 = "mesa"
#PREFERRED_PROVIDER_virtual/libgles2 = "mesa"
#PREFERRED_PROVIDER_virtual/egl = "mesa"


TOOLCHAIN_HOST_TASK:append = " \
    nativesdk-qtbase \
    nativesdk-qttools \
    nativesdk-qtdeclarative \
"

IMAGE_INSTALL:append = " mesa"
IMAGE_INSTALL:append = " rsync coreutils"

IMAGE_INSTALL:append = " fontconfig fontconfig-utils ttf-dejavu-sans ttf-dejavu-sans-mono"

IMAGE_INSTALL:append = " \
	qt3d \
	qt5-plugin-generic-vboxtouch \
	qtbase \
	qtbase-plugins \
	qtcharts \
	qtconnectivity \
	qtdatavis3d \
	qtdeclarative \
	qtgraphicaleffects \
	qtimageformats \
	qtlocation \
	qtmultimedia \
	qtquickcontrols2 \
	qtquickcontrols \
	qtscript \
	qtsensors \
	qtserialport \
	qtsvg \
	qtsystems \
	qttools \
	qttranslations \
	qtvirtualkeyboard \
	qtwebchannel \
	qtwebsockets \
	qtxmlpatterns \
	openssh-sftp-server \
	gdb \
	gdbserver\
"
PACKAGECONFIG:pn-gstreamer1.0-plugins-base = " orc gles2"
PACKAGECONFIG:pn-gstreamer1.0-plugins-bad = " orc"

ESDK_LOCALCONF_ALLOW += "IMAGE_LINGUAS"
ESDK_LOCALCONF_REMOVE += "IMAGE_LINGUAS"
IMAGE_LINGUAS = "en-us"
```
